## conf/layer.conf
```bitbake
# We have a conf and classes directory, add to BBPATH
BBPATH .= ":${LAYERDIR}"

# We have recipes-* directories, add to BBFILES
BBFILES += "${LAYERDIR}/recipes-*/*/*.bb \
    ${LAYERDIR}/recipes-*/*/*.bbappend"

BBFILE_COLLECTIONS += "rcar-dutest"
BBFILE_PATTERN_rcar-dutest = "^${LAYERDIR}/"
BBFILE_PRIORITY_rcar-dutest = "6"
LAYERSERIES_COMPAT_rcar-dutest = "dunfell"

LAYERDEPENDS_rcar-dutest = "core yocto yoctobsp openembedded-layer meta-python"
```
